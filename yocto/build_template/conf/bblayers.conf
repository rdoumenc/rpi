## yocto/build_template/conf/bblayers.conf
```bitbake
# LAYER_CONF_VERSION is increased each time build/conf/bblayers.conf
# changes incompatibly
POKY_BBLAYERS_CONF_VERSION = "1"

BBPATH = "${TOPDIR}"
BBFILES ?= ""

YOCTODIR := "${@os.path.abspath(os.path.join("${TOPDIR}", os.pardir, "yocto"))}"

BBLAYERS ?= " \
  ${YOCTODIR}/poky/meta \
  ${YOCTODIR}/poky/meta-poky \
  ${YOCTODIR}/poky/meta-yocto-bsp \
  ${YOCTODIR}/meta-raspberrypi \
  ${YOCTODIR}/meta-openembedded/meta-oe \
  ${YOCTODIR}/meta-qt5 \  
  ${YOCTODIR}/meta-iot \
  ${YOCTODIR}/meta-custom \
  ${YOCTODIR}/meta-app \
  "

BBLAYERS_NON_REMOVABLE ?= " \
  ${YOCTODIR}/poky/meta \
  ${YOCTODIR}/poky/meta-poky \
  "
```
